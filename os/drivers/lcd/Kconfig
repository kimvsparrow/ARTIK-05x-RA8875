## os/drivers/lcd/Kconfig
```kconfig
#
# For a description of the syntax of this configuration file,
# see kconfig-language at https://www.kernel.org/doc/Documentation/kbuild/kconfig-language.txt
#

comment "Common LCD Settings"

config LCD_NOGETRUN
	bool "Write-only LCD"
	default n
	---help---
		Many LCD hardware interfaces provide only minimal graphics capability.  In
		particulary, many simple LCD interfaces are write only.  That is we, can
		write graphics data to the LCD device memory, but we cannot read it back.
		If the LCD hardware does not support reading the graphics memory, then
		this option should be defined so that the NX layer can taking alternative
		measures when the LCD is not readable.  For example, if the LCD is not
		readable, then NX will not attempt to support transparency.

		See also NX_WRITEONLY in the graphics support menu.

config LCD_MAXCONTRAST
	int "LCD maximum contrast"
	default 63
	range 1 255
	---help---
		must be 63 with the Epson controller and 127 with
		the Phillips controller.

config LCD_MAXPOWER
	int "LCD maximum power"
	default 255 if LCD_RA8875
	default 1
	range 1 255
	---help---
		Maximum value of LCD power setting.  This normally equates to brightness:
		The brighter the screen, the hight the power usage.

		On LCDs that have a backlight, this value corresponds directly to that
		backlight setting.  Board-specific logic may place restrictions on this
		value.

comment "Graphic LCD Devices"

choice
	prompt "LCD Orientation"
	default LCD_LANDSCAPE
	depends on LCD
	---help---
		Some LCD drivers may support displays in different orientations.
		If the LCD driver supports this capability, than these are configuration
		options to select that display orientation.

config LCD_LANDSCAPE
	bool "Landscape orientation"
	---help---
		Define for "landscape" orientation support.  Landscape mode refers one
		of two orientations where the display is wider than it is tall
		(LCD_RLANDSCAPE is the other).  This is the default orientation.

config LCD_PORTRAIT
	bool "Portrait orientation"
	---help---
		Define for "portrait" orientation support.  Portrait mode refers one
		of two orientations where the display is taller than it is wide
		(LCD_RPORTAIT is the other).

config LCD_RPORTRAIT
	bool "Reverse portrait display"
	---help---
		Define for "reverse portrait" orientation support.  Reverse portrait mode
		refers one of two orientations where the display is taller than it is
		wide (LCD_PORTAIT is the other).

config LCD_RLANDSCAPE
	bool "Reverse landscape orientation"
	---help---
		Define for "reverse landscape" orientation support.  Reverse landscape mode
		refers one of two orientations where the display is wider than it is
		tall (LCD_LANDSCAPE is the other).

endchoice

config LCD_ILI9341
	bool "ILI9341 LCD Single Chip Driver"
	default n
	---help---
		LCD Single Chip Driver, ILI9341, ILI Technology Corp. Used
		with the STM32F429i Discovery Board.

		Required LCD driver settings:
		LCD_MAXCONTRAST should be 255, but any value >0 and <=255 will be accepted.
		LCD_MAXPOWER should be 1:  0=off, 1=on

config LCD_ILI9341_NINTERFACES
	int "Number of supported display driver"
	range 1 2
	default 1
    depends on LCD_ILI9341
	---help---
		Define the number of supported  displays driven by a ili9341 LCD Single
		Chip Driver.

config LCD_ILI9341_IFACE0
	bool "(1) LCD Display"
	depends on LCD_ILI9341_NINTERFACES = 1 || LCD_ILI9341_NINTERFACES = 2
	---help---
		Configure first LCD Display.

if LCD_ILI9341_IFACE0
choice
	prompt "LCD Orientation"
	default LCD_ILI9341_IFACE0_LANDSCAPE
	---help---
		Configure display orientation.

config LCD_ILI9341_IFACE0_LANDSCAPE
	bool "Landscape orientation"
	---help---
		Define for "landscape" orientation support.

config LCD_ILI9341_IFACE0_PORTRAIT
	bool "Portrait orientation"
	---help---
		Define for "portrait" orientation support.

config LCD_ILI9341_IFACE0_RLANDSCAPE
	bool "Reverse landscape orientation"
	---help---
		Define for "reverse landscape" orientation support.

config LCD_ILI9341_IFACE0_RPORTRAIT
	bool "Reverse portrait display"
	---help---
		Define for "reverse portrait" orientation support.

endchoice

choice
	prompt "Color format"
	default LCD_ILI9341_IFACE0_RGB565
	---help---
		LCD color format.

config LCD_ILI9341_IFACE0_RGB565
	bool "16 bpp RGB565 color format"
	---help---
		16 bpp RGB565 color format

endchoice
endif

config LCD_ILI9341_IFACE1
	bool "(2) LCD Display"
	depends on LCD_ILI9341_NINTERFACES = 2
	---help---
		Configure second LCD Display.

if LCD_ILI9341_IFACE1
choice
	prompt "LCD Orientation"
	default LCD_ILI9341_IFACE1_LANDSCAPE
	---help---
		Configure display orientation.

config LCD_ILI9341_IFACE1_LANDSCAPE
	bool "Landscape orientation"
	---help---
		Define for "landscape" orientation support.

config LCD_ILI9341_IFACE1_PORTRAIT
	bool "Portrait orientation"
	---help---
		Define for "portrait" orientation support.

config LCD_ILI9341_IFACE1_RLANDSCAPE
	bool "Reverse landscape orientation"
	---help---
		Define for "reverse landscape" orientation support.

config LCD_ILI9341_IFACE1_RPORTRAIT
	bool "Reverse portrait display"
	---help---
		Define for "reverse portrait" orientation support.

endchoice

choice
	prompt "Color format"
	default LCD_ILI9341_IFACE1_RGB565
	---help---
		LCD color format.

config LCD_ILI9341_IFACE1_RGB565
	bool "16 bpp RGB565 color format"
	---help---
		16 bpp RGB565 color format

endchoice
endif

config LCD_RA8875
	bool "RA8875 LCD Display Controller"
	default n
	---help---
		LCD controller driver for RA8875 by RAiO Technologies Inc.

if LCD_RA8875

choice
	prompt "MCU-RA8875 Interface"
	default LCD_RA8875_SPI_4WIRE
	---help---
		RA8875 MCU-RA8875 hardware interface

config LCD_RA8875_SPI_4WIRE
	bool "SPI 4-Wire"

config LCD_RA8875_I2C
	bool "I2C (unsupported)"

config LCD_RA8875_8BIT
	bool "8 bit (unsupported)"

config LCD_RA8875_16BIT
	bool "16 bit (unsupported)"

endchoice # MCU Interface

if LCD_RA8875_SPI_4WIRE
config LCD_RA8875_SPI_4WIRE_BUS
	int "RA8875 SPI bus number"
	range 0 1
	default 0
endif # LCD_RA8875_SPI_4WIRE

config RA8875_XRES
	int "RA8875 display width in pixels"
	default 800

config RA8875_YRES
	int "RA8875 display height in pixels"
	default 480

choice
	prompt "Colors"
	default LCD_RA8875_65K
	---help---
		Number of colors/color depth

config LCD_RA8875_256
	bool "256 / 8 bit"

config LCD_RA8875_65K
	bool "65k / 16 bit"

endchoice # Colors

config LCD_RA8875_EXTENDED
	bool "Extended drawing interfaces"
	default n
	depends on BUILD_FLAT
	---help---
		Build in some non-standard, custom drawing interfaces for the RA8875
		including the following: ra8875_drawrectangle(), ra8875_drawline(),
		ra8875_drawtriangle(), and ra8875_drawcircle().  NOTE that these
		will not be accessible by applications in protected or kernel build
		configurations.

		NOTE: The non-standard ra8875_clear(), ra8875_drawrectangle(),
		ra8875_drawline() interfaces are always built and available for use
		because within the OS because these are used internally by the
		driver anyway.

config LCD_RA8875_RESET
	bool "Perform RA8875 software reset"
	default n
	---help---
		Attempt to perform a software reset of the RA8875 chip via the PWRR
		registers. This sequence does not seem to work (at least over SPI).

endif # LCD_RA8875
```
